## services/user_datalogger/config.in
```kconfig
dep_bool_menu "Data Logger(EXPERIMENTAL)" DATA_LOGGER_SUPPORT $CONFIG_EXPERIMENTAL
	choice '  Datalogger USART ' "$(usart_choice DATA_LOGGER)"
	usart_process_choice DATA_LOGGER
    
    dep_bool "S0-Logger" DATA_LOGGER_S0
    dep_bool_menu "Kaco-Logger" DATA_LOGGER_KACO
        int    "Max Kaco Bus-ID" DATA_LOGGER_KACO_MAX 1
    endmenu
    
    dep_bool "Vitodens-GWG" DATA_LOGGER_VITO
	comment "Debugging Flags"
	dep_bool "Debug S0" DEBUG_S0 $DEBUG $DATA_LOGGER_S0
	dep_bool "Debug Kaco" DEBUG_KACO $DEBUG $DATA_LOGGER_KACO
	dep_bool "Debug Logger" DEBUG_LOGGER $DEBUG
endmenu
```
